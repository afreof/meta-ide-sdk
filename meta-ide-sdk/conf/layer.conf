## meta-ide-sdk/conf/layer.conf
```bitbake
# We have a conf and classes directory, add to BBPATH
BBPATH .= ":${LAYERDIR}"

# We have recipes-* directories, add to BBFILES
BBFILES += "${LAYERDIR}/recipes-*/*/*.bb \
            ${LAYERDIR}/recipes-*/*/*.bbappend"

BBFILE_COLLECTIONS += "meta-ide-sdk"
BBFILE_PATTERN_meta-ide-sdk = "^${LAYERDIR}/"
BBFILE_PRIORITY_meta-ide-sdk = "50"

LAYERDEPENDS_meta-ide-sdk = "core"
LAYERSERIES_COMPAT_meta-ide-sdk = "nanbield"
```
